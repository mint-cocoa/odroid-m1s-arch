## scripts/u-boot/FIT.its
```
/dts-v1/;

/ {
    description = "FIT Image with BL31, BL32, Kernel, DTB, and Initramfs";
    #address-cells = <1>;

    images {
        bl31 {
            description = "ARM Trusted Firmware BL31";
            data = /incbin/("/usr/src/rkbin/bin/rk35/rk3568_bl31_v1.44.elf");
            type = "firmware";
            arch = "arm64";
            os = "arm-trusted-firmware";
            compression = "none";
            load = <0x00040000>;
            entry = <0x00040000>;
        };

        bl32 {
            description = "OP-TEE BL32";
            data = /incbin/("/usr/src/rkbin/bin/rk35/rk3568_bl32_v2.11.bin");
            type = "firmware";
            arch = "arm64";
            os = "tee";
            compression = "none";
            load = <0x08400000>;
            entry = <0x08400000>;
        };

        kernel {
            description = "Linux Kernel";
            data = /incbin/("/usr/src/linux/arch/arm64/boot/Image");
            type = "kernel";
            arch = "arm64";
            os = "linux";
            compression = "none";
            load = <0x80000>;
            entry = <0x80000>;
        };

        fdt {
            description = "Device Tree Blob";
            data = /incbin/("/usr/src/linux/arch/arm64/boot/dts/rockchip/rk3566-odroid-m1s.dtb");
            type = "flat_dt";
            arch = "arm64";
            compression = "none";
            load = <0x83000000>;
        };

        ramdisk {
            description = "Initramfs";
            data = /incbin/("path/to/initramfs.cpio.gz");
            type = "ramdisk";
            arch = "arm64";
            os = "linux";
            compression = "gzip";
            load = <0x84000000>;
        };
    };

    configurations {
        default = "conf";
        conf {
            description = "Default Configuration";
            firmware = "bl31";
            firmware = "bl32";
            kernel = "kernel";
            fdt = "fdt";
            ramdisk = "ramdisk";
        };
    };
};
```
